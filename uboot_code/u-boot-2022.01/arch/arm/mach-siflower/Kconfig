## uboot_code/u-boot-2022.01/arch/arm/mach-siflower/Kconfig
```kconfig
if ARCH_SIFLOWER

config SYS_SOC
	default "siflower"

config SYS_VENDOR
	default "siflower"

config SF21H8898
	bool "Siflower SF21H8898 SoC"

config SF21H8898_MPW0
	bool "Select Siflower SF21H8898 MPW0 SoC"
	select SYS_HAS_ARMV8_SECURE_BASE

choice
	prompt "Siflower board select"

config TARGET_SF21H8898
	bool "Siflower SF21H8898 SoC"
	select ARM64
	select ARMV8_SET_SMPEN
	select GICV3
	help
	  Siflower SF21H8898 Soc.

endchoice

config SYS_BOARD
	string "Board name"
	default "sf21h8898" if TARGET_SF21H8898
	default ""
	help
	  This option contains information about board name.
	  Based on this option board/<CONFIG_SYS_VENDOR>/<CONFIG_SYS_BOARD> will
	  be used.

config SYS_CONFIG_NAME
	string "Board configuration name"
	default "sf21h8898" if TARGET_SF21H8898
	default ""
	help
	  This option contains information about board configuration name.
	  Based on this option include/configs/<CONFIG_SYS_CONFIG_NAME>.h header
	  will be used for board configuration.
endif
```

## uboot_code/u-boot-2022.01/arch/riscv/cpu/siflower/Kconfig
```kconfig
config SYS_SOC
	default "siflower"

config SYS_VENDOR
	default "siflower"

config SF21H8898
	bool "Siflower SF21H8898 SoC"

config SF23A2892
	bool "Siflower SF23A2892 SoC"

config SF21A6826
	bool "Siflower SF21A6826 SoC"
	select BINMAN

config SYS_BOARD
	string "Board name"
	default "riscv" if TARGET_SF21H8898_V2
	default "riscv" if TARGET_SF23A2892
	default "riscv" if TARGET_SF21A6826
	default ""
	help
	  This option contains information about board name.
	  Based on this option board/<CONFIG_SYS_VENDOR>/<CONFIG_SYS_BOARD> will
	  be used.

config SYS_CONFIG_NAME
	string "Board configuration name"
	default "sf21h8898" if TARGET_SF21H8898
	default "sf23a2892" if TARGET_SF23A2892
	default "sf21a6826" if TARGET_SF21A6826
	default ""
	help
	  This option contains information about board configuration name.
	  Based on this option include/configs/<CONFIG_SYS_CONFIG_NAME>.h header
	  will be used for board configuration.

config SIFLOWER_UBOOT_COMPRESSED
	bool "Build FIT image with u-boot compressed"
```

## uboot_code/u-boot-2022.01/board/siflower/riscv/Kconfig
```kconfig
# SPDX-License-Identifier: GPL-2.0+
# Copyright (C) 2019-20 Sean Anderson <seanga2@gmail.com>

if TARGET_SF21H8898_V2

config SYS_BOARD
	default "riscv"

config SYS_VENDOR
	default "siflower"

config SYS_CPU
	default "siflower"

config SYS_CONFIG_NAME
	default "sf21h8898"

config SYS_TEXT_BASE
	default 0x80000000

config DEFAULT_DEVICE_TREE
	default "sf21h8898_fullmask_evb"

config NR_CPUS
	default 2

config NR_DRAM_BANKS
	default 1

config BOARD_SPECIFIC_OPTIONS
	def_bool y
	imply DM_SERIAL
	imply CPU
	imply PL011_SERIAL
#	imply SIFIVE_CLINT
	imply POWER_DOMAIN
#	imply SIMPLE_PM_BUS
#	imply DM_RESET
#	imply RESET_SYSCON
#	imply SYSRESET
#	imply SYSRESET_SYSCON
	imply PINCTRL
	imply PINCONF
#	imply PINCTRL_K210
	imply DM_GPIO
	imply SFAX8_GPIO
#	imply CMD_GPIO
#	imply LED
#	imply LED_GPIO
	imply SPI
	imply DESIGNWARE_SPI
	imply SF_EXSPI
	imply SPI_FLASH_GIGADEVICE
	imply SPI_FLASH_WINBOND
#	imply DM_MTD
#	imply SPI_FLASH_MTD
#	imply CMD_MTD
#	imply ENV_IS_IN_SPI_FLASH
	imply DOS_PARTITION
	imply EFI_PARTITION
#	imply CMD_PART
#	imply CMD_FS_GENERIC
endif

if TARGET_SF23A2892

config SYS_BOARD
	default "riscv"

config SYS_VENDOR
	default "siflower"

config SYS_CPU
	default "siflower"

config SYS_CONFIG_NAME
	default "sf23a2892"

config SYS_TEXT_BASE
	default 0x80000000

config DEFAULT_DEVICE_TREE
	default "sf23a2892_fullmask_evb"

config NR_CPUS
	default 2

config NR_DRAM_BANKS
	default 1

config BOARD_SPECIFIC_OPTIONS
	def_bool y
	imply DM_SERIAL
	imply CPU
	imply PL011_SERIAL
#	imply SIFIVE_CLINT
	imply POWER_DOMAIN
#	imply SIMPLE_PM_BUS
#	imply DM_RESET
#	imply RESET_SYSCON
#	imply SYSRESET
#	imply SYSRESET_SYSCON
	imply PINCTRL
	imply PINCONF
#	imply PINCTRL_K210
	imply DM_GPIO
	imply SFAX8_GPIO
#	imply CMD_GPIO
#	imply LED
#	imply LED_GPIO
	imply SPI
	imply DESIGNWARE_SPI
	imply SF_EXSPI
	imply SPI_FLASH_GIGADEVICE
	imply SPI_FLASH_WINBOND
#	imply DM_MTD
#	imply SPI_FLASH_MTD
#	imply CMD_MTD
#	imply ENV_IS_IN_SPI_FLASH
	imply DOS_PARTITION
	imply EFI_PARTITION
#	imply CMD_PART
#	imply CMD_FS_GENERIC
endif

if TARGET_SF21A6826

config SYS_BOARD
	default "riscv"

config SYS_VENDOR
	default "siflower"

config SYS_CPU
	default "siflower"

config SYS_CONFIG_NAME
	default "sf21a6826"

config SYS_TEXT_BASE
	default 0x80000000

config DEFAULT_DEVICE_TREE
	default "sf21a6826_fullmask_evb"

config NR_CPUS
	default 2

config NR_DRAM_BANKS
	default 3

config BOARD_SPECIFIC_OPTIONS
	def_bool y
	imply DM_SERIAL
	imply CPU
	imply PL011_SERIAL
#	imply SIFIVE_CLINT
	imply POWER_DOMAIN
#	imply SIMPLE_PM_BUS
#	imply DM_RESET
#	imply RESET_SYSCON
#	imply SYSRESET
#	imply SYSRESET_SYSCON
	imply PINCTRL
	imply PINCONF
#	imply PINCTRL_K210
	imply DM_GPIO
	imply SFAX8_GPIO
#	imply CMD_GPIO
#	imply LED
#	imply LED_GPIO
	imply SPI
	imply DESIGNWARE_SPI
	imply SF_EXSPI
	imply SPI_FLASH_GIGADEVICE
	imply SPI_FLASH_WINBOND
#	imply DM_MTD
#	imply SPI_FLASH_MTD
#	imply CMD_MTD
#	imply ENV_IS_IN_SPI_FLASH
	imply DOS_PARTITION
	imply EFI_PARTITION
#	imply CMD_PART
#	imply CMD_FS_GENERIC
endif
```

## uboot_code/u-boot-2022.01/configs/sf21a6826_fullmask_6826sg_defconfig
```kconfig
CONFIG_RISCV=y
CONFIG_RISCV_MMODE=y
CONFIG_CMODEL_MEDANY=y
CONFIG_ARCH_SIFLOWER=y
CONFIG_PINCTRL=y
CONFIG_PINCTRL_SINGLE=y
CONFIG_SFAX8_GPIO=y
CONFIG_SYS_TEXT_BASE=0x20000000
CONFIG_SYS_MALLOC_LEN=0x1000000
CONFIG_SYS_MALLOC_F_LEN=0x4000
# CONFIG_SYS_MALLOC_CLEAR_ON_INIT is not set
CONFIG_SF21A6826=y
CONFIG_BUILD_TARGET=""
CONFIG_TARGET_SF21A6826=y
CONFIG_SYS_LOAD_ADDR=0x22000000
CONFIG_PL01X_SERIAL=y
CONFIG_DEFAULT_DEVICE_TREE="sf21a6826_fullmask_6826sg"
CONFIG_CONS_INDEX=1
CONFIG_SYS_PROMPT="sf21a6826> "
CONFIG_OF_REAL=y
CONFIG_DM=y
CONFIG_DM_GPIO=y
CONFIG_DM_MDIO=y
CONFIG_DM_SPI_FLASH=y
CONFIG_DM_ETH=y
CONFIG_DM_ETH_PHY=y
CONFIG_DMA=y
CONFIG_DMA_CHANNELS=y
CONFIG_PHY_GIGE=y
CONFIG_PHY_SIFLOWER=y
CONFIG_SF_EXSPI=y
CONFIG_TIMER=y
CONFIG_RISCV_TIMER=y
CONFIG_DESIGNWARE_WATCHDOG=y
CONFIG_CPU_RISCV=y
CONFIG_WDT=y
CONFIG_SF_XGMAC=y
CONFIG_SF_XGMAC_DMA=y
CONFIG_SF_XPCS=y
CONFIG_SPI=y
CONFIG_DM_SPI=y
CONFIG_CLK=y
CONFIG_SPI_FLASH_WINBOND=y
CONFIG_SPI_FLASH_EON=y
CONFIG_SPI_FLASH_ISSI=y
# CONFIG_SPI_FLASH_USE_4K_SECTORS is not set
CONFIG_SIMPLE_BUS_CORRECT_RANGE=y
CONFIG_DEVRES=y
CONFIG_NET_RANDOM_ETHADDR=y
CONFIG_CMD_MDIO=y
CONFIG_CMD_MTD=y
CONFIG_CMD_PING=y
CONFIG_CMD_HTTPD=y
# CONFIG_CMD_SF is not set
# CONFIG_EFI_LOADER is not set
CONFIG_CMD_MULUP=y
CONFIG_FIT=y
CONFIG_BOOTDELAY=3
CONFIG_MTD=y
CONFIG_SPI_FLASH_MTD=y
CONFIG_SPI_FLASH_SFDP_SUPPORT=y
CONFIG_SF_DEFAULT_SPEED=10000000
CONFIG_USE_BOOTCOMMAND=y
CONFIG_BOOTCOMMAND="mtd read nor0 $loadaddr 0xa0000 0x1000 && imsz $loadaddr imagesize && mtd read nor0 $loadaddr 0xa0000 $imagesize && bootm"
CONFIG_HUSH_PARSER=y
# CONFIG_MMC is not set
```

## uboot_code/u-boot-2022.01/configs/sf21h8898_siflower-one-nor_defconfig
```kconfig
CONFIG_RISCV=y
CONFIG_SYS_TEXT_BASE=0x20000000
CONFIG_SYS_MALLOC_LEN=0x1000000
CONFIG_SYS_MALLOC_F_LEN=0x4000
CONFIG_DEFAULT_DEVICE_TREE="sf21h8898_siflower_one-nor"
CONFIG_TARGET_SF21A6826=y
CONFIG_SF21A6826=y
CONFIG_CMODEL_MEDANY=y
CONFIG_RISCV_SMODE=y
# CONFIG_OF_BOARD_FIXUP is not set
# CONFIG_SYS_MALLOC_CLEAR_ON_INIT is not set
CONFIG_SYS_LOAD_ADDR=0x22000000
CONFIG_FIT=y
CONFIG_BOOTDELAY=3
CONFIG_USE_BOOTCOMMAND=y
CONFIG_BOOTCOMMAND="mtd read FIRMWARE $loadaddr 0x0 0x1000 && imsz $loadaddr imagesize && mtd read FIRMWARE $loadaddr 0x0 $imagesize && bootm"
CONFIG_HUSH_PARSER=y
CONFIG_SYS_PROMPT="sf21h88> "
CONFIG_CMD_MTD=y
# CONFIG_CMD_SF is not set
CONFIG_CMD_MDIO=y
CONFIG_CMD_PING=y
CONFIG_CMD_HTTPD=y
CONFIG_CMD_MULUP=y
CONFIG_NET_RANDOM_ETHADDR=y
CONFIG_DEVRES=y
CONFIG_SIMPLE_BUS_CORRECT_RANGE=y
CONFIG_BUTTON=y
CONFIG_BUTTON_GPIO=y
CONFIG_CPU_RISCV=y
CONFIG_DMA=y
# CONFIG_INPUT is not set
CONFIG_LED=y
CONFIG_LED_GPIO=y
CONFIG_DM_MTD=y
CONFIG_SF_DEFAULT_SPEED=10000000
CONFIG_SPI_FLASH_SFDP_SUPPORT=y
# CONFIG_SPI_FLASH_USE_4K_SECTORS is not set
CONFIG_SPI_FLASH_MTD=y
CONFIG_SPI_FLASH_GIGADEVICE=y
CONFIG_SPI_FLASH_ISSI=y
CONFIG_PHY_SIFLOWER=y
CONFIG_PHY_FIXED=y
CONFIG_DM_ETH_PHY=y
CONFIG_PHY_GIGE=y
CONFIG_SF_XGMAC=y
CONFIG_PINCTRL_SINGLE=y
CONFIG_PL01X_SERIAL=y
# CONFIG_DESIGNWARE_SPI is not set
CONFIG_RISCV_TIMER=y
CONFIG_DESIGNWARE_WATCHDOG=y
CONFIG_WDT=y
# CONFIG_EFI_LOADER is not set
```

## uboot_code/u-boot-2022.01/drivers/crypto/siflowerhash/Kconfig
```kconfig
config SF_HASH
	bool "Siflower Crypto Driver Support"
	select SF_SHA_HW_ACCEL
	imply SPL_CRYPTO if (ARM && SPL)
	imply CMD_HASH
	help
	  Enables the Siflower hash for Kernel Secure Boot
```

## uboot_code/u-boot-2022.01/drivers/net/sf_npu/Kconfig
```kconfig
config DRIVER_SF_NPU
	bool "Siflower Common Platform Ethernet Driver"
	default n
	help
	  This driver just supports table config now.
```
